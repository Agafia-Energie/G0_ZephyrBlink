## boardfiles/agafia_sg0/Kconfig.agafia_sg0
```kconfig
# Copyright (c) 2019 STMicroelectronics
# SPDX-License-Identifier: Apache-2.0

config BOARD_AGAFIA_SG0
	select SOC_STM32G071XX
```

## boardfiles/agafia_sg0/board.yml
```yaml
board:
  name: agafia_sg0
  full_name: Agafia SG0
  vendor: st
  socs:
    - name: stm32g071xx
```
